## meta-iot2000-bsp/conf/machine/iot2000.conf
```bitbake
#@TYPE: Machine
#@NAME: iot2000

#@DESCRIPTION: Machine configuration for iot2000 systems

MACHINEOVERRIDES =. "intel-quark:"

# meta-intel switched to an own kernel source, but we stay with linux-yocto
# to have the 4.4 option with a smooth migration path to 4.4-cip
PREFERRED_PROVIDER_virtual/kernel ?= "linux-yocto"

require conf/machine/include/meta-intel.inc
require conf/machine/include/intel-quark-common.inc
require conf/machine/include/intel-common-pkgarch.inc

# Yocto 2.2 comes with 4.8, but that kernel is already EOL upstream
PREFERRED_VERSION_linux-yocto = "4.4%"
PREFERRED_VERSION_linux-yocto-rt = "4.4%"

#Avoid pulling in GRUB
MACHINE_ESSENTIAL_EXTRA_RDEPENDS = ""

MACHINE_FEATURES = "efi usb"

MACHINE_EXTRA_RRECOMMENDS += "kernel-modules linux-firmware"

SERIAL_CONSOLE = "115200 ttyS1"
APPEND += "rootwait console=ttyS1,115200 console=tty0"

# Use efibootguard as the bootloader
EFI_PROVIDER = "efibootguard"
NOISO = "1"
do_image_wic[depends] += "gptfdisk-native:do_populate_sysroot"

# Ensure that the Lock prefix is omitted for the kernel"
KERNEL_EXTRA_ARGS = "EXTRA_CFLAGS=-Wa,-momit-lock-prefix=yes"

# Machine specific Image packages:
IMAGE_INSTALL_append = " kernel-modules"

# Package compatiblity:
PACKAGE_EXTRA_ARCHS_append = " intel-quark quark i586 x86"

EXTRA_IMAGEDEPENDS_append = " acpi-upgrades"
INITRD_LIVE_prepend = "${DEPLOY_DIR_IMAGE}/acpi-upgrades-${MACHINE}.cpio "

# Generate compressed EXT4 images for swupdate
IMAGE_FSTYPES += " ext4.gz"

MACHINE_FEATURES += "swupdate"
IMAGE_FSTYPES += "${@bb.utils.contains('COMBINED_FEATURES', 'swupdate', 'ext4.swu', '', d)}"

MACHINE_BOOT_FILES = "bzImage"
```

## meta-iot2000-bsp/scripts/lib/wic/canned-wks/wic-image.iot2000.wks
```
# short-description: Create an IOT2000 disk image
# long-description: Creates a partitioned EFI disk image for the SIMATIC IOT2000
# that the user can directly dd to boot media.

part /boot --source bootimg-efi --sourceparams="loader=gummiboot" --ondisk mmcblk0 --label msdos --active --align 1024

part / --source rootfs --ondisk mmcblk0 --fstype=ext3 --label pf_a --align 1024 --size 512M --extra-space 0
part / --source rootfs --ondisk mmcblk0 --fstype=ext3 --label pf_b --align 1024 --size 512M --extra-space 0
part / --source rootfs --ondisk mmcblk0 --fstype=ext3 --label pf_f --align 1024 --size 512M --extra-space 0
part --ondisk mmcblk0 --fstype=ext3 --label pf_data --align 1024 --size 512M

bootloader  --timeout=0  --append="console=ttyS1,115200n8 reboot=efi,warm rw debugshell=5 rootwait initrd=EFI/BOOT/acpi-upgrades-iot2000.cpio"
```
